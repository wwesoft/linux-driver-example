## drivers/input/keyboard/Kconfig
```kconfig
#
# Input core configuration
#
menuconfig INPUT_KEYBOARD
	bool "Keyboards" if EXPERT || !X86
	default y
	help
	  Say Y here, and a list of supported keyboards will be displayed.
	  This option doesn't affect the kernel.

	  If unsure, say Y.

if INPUT_KEYBOARD


config KEYBOARD_QT60248
	tristate "QT60248 Touch Sensor Chip"
	depends on SPI && EXPERIMENTAL
	help
	  If you say yes here you get support for QT60248 Touch
	  Sensor chip as a keyboard input.

	  This driver can also be built as a module. If so, the module
	  will be called qt60248.


endif
```
